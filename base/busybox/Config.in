## base/busybox/Config.in
```kconfig
if PACKAGE_busybox

config BUSYBOX_CUSTOM
	bool "Customize busybox options - extra "
	default y
        help
	    extra config for krescue

	source "Config-defaults.in"

	if BUSYBOX_CUSTOM
	source "config/Config.in"
	endif

endif
```
